## feature/audio_beep/Kconfig
```kconfig
config FEATURE_AUDIO_BEEP
	tristate "application audio_beep"
	default y
	---help---
		Enable the audio_beep app

if FEATURE_AUDIO_BEEP

config FEATURE_AUDIO_BEEP_PROGNAME
	string "Program name"
	default "audio_beep"
	---help---
		This is the name of the program that will be use when the NSH ELF
		program is installed.

config FEATURE_AUDIO_BEEP_PRIORITY
	int "audio_beep task priority"
	default 100

config FEATURE_AUDIO_BEEP_STACKSIZE
	int "audio_beep stack size"
	default 2048

endif
```

## feature/orgel/Kconfig
```kconfig
config FEATURE_ORGEL
	tristate "application orgel"
	default y
	---help---
		Enable the orgel app

if FEATURE_ORGEL

config FEATURE_ORGEL_PROGNAME
	string "Program name"
	default "orgel"
	---help---
		This is the name of the program that will be use when the NSH ELF
		program is installed.

config FEATURE_ORGEL_PRIORITY
	int "orgel task priority"
	default 100

config FEATURE_ORGEL_STACKSIZE
	int "orgel stack size"
	default 2048

endif
```
